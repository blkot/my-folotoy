## firmware/usage-monitor/main/Kconfig.projbuild
```kconfig
menu "Usage monitor"

config USAGE_WIFI_SSID
    string "Wi-Fi SSID"
    default ""

config USAGE_WIFI_PASSWORD
    string "Wi-Fi password"
    default ""

config USAGE_SERVER_HOST
    string "Usage server host (NAS IP or hostname)"
    default "192.168.50.88"

config USAGE_SERVER_PORT
    int "Usage server TCP port"
    default 8090

config USAGE_SERVER_PATH
    string "Usage endpoint path"
    default "/api/usage.txt"

config USAGE_REFRESH_SECONDS
    int "Refresh interval (seconds; 0 = only on demand)"
    default 60

config USAGE_TIMEZONE_OFFSET
    int "Local time offset from UTC, in hours (for reset countdowns)"
    default 8

endmenu
```

## firmware/visual-novel/main/Kconfig.projbuild
```kconfig
menu "VN visual novel app"

config VN_WIFI_SSID
    string "Wi-Fi SSID (build-time; leave empty to fall back to the developer menu)"
    default ""

config VN_WIFI_PASSWORD
    string "Wi-Fi password"
    default ""

config VN_SERVER_HOST
    string "VN content server host or IP"
    default "192.168.1.100"

config VN_SERVER_PORT
    int "VN content server port"
    default 8080

config VN_START_NODE
    string "Start node id"
    default "start"

endmenu
```

## firmware/voice-bot/main/Kconfig.projbuild
```kconfig
menu "AI voice bot (walkie-talkie)"

config VOICE_WIFI_SSID
    string "Wi-Fi SSID"
    default ""

config VOICE_WIFI_PASSWORD
    string "Wi-Fi password"
    default ""

config VOICE_SERVER_HOST
    string "Voice server IP (the PC running voice-server/voice_server.py)"
    default "192.168.50.88"

config VOICE_SERVER_PORT
    int "Voice server TCP port"
    default 8090

config VOICE_SAMPLE_RATE
    int "Audio sample rate (Hz; 16000 is what STT wants)"
    default 16000

config VOICE_SPEAKER_VOLUME
    int "Speaker volume (0-100; the BSP default is 0 = silent)"
    range 0 100
    default 85

config VOICE_CHUNK_MS
    int "Capture/playback chunk size (ms; 20 = 640 B at 16 kHz mono)"
    default 20

endmenu
```
